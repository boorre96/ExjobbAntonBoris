## CMakeLists.txt
```
#-------------------------------------------------------------------------------
# Zephyr Example Application
#
# Copyright (c) 2021 Nordic Semiconductor ASA
# SPDX-License-Identifier: Apache-2.0

cmake_minimum_required(VERSION 3.13.1)
find_package(Zephyr REQUIRED HINTS $ENV{ZEPHYR_BASE})

# Project build
project(app)

# From nanopb
nanopb_generate_cpp(proto_sources proto_headers RELPATH .
    src/simple.proto
)

# We need to be able to include generated header files
zephyr_library_include_directories(${CMAKE_CURRENT_BINARY_DIR})


configure_file(app_version.h.in ${CMAKE_BINARY_DIR}/app/include/app_version.h)
target_include_directories(app PRIVATE ${CMAKE_BINARY_DIR}/app/include src)


if(CONFIG_ZTEST)
    target_sources(app PRIVATE ${proto_sources})
    target_include_directories(app PRIVATE
        ${ZEPHYR_BASE}/include   
    tests/bmi160_test/src)
    target_sources(app PRIVATE tests/bmi160_test/src/test_bmi160.c)

else()
    target_sources(app PRIVATE ${proto_sources} src/main.c)
endif()
```

## prj.conf
```kconfig
# Copyright (c) 2021 Nordic Semiconductor ASA
# SPDX-License-Identifier: Apache-2.0
#
# This file contains selected Kconfig options for the application.

CONFIG_SENSOR=y
CONFIG_NANOPB=y
CONFIG_LOG=y

# Enable networking
CONFIG_NETWORKING=y

# Enable IPv4 support
CONFIG_NET_IPV4=y

# Enable IPv6 support if needed
CONFIG_NET_IPV6=n

# Enable TCP support
CONFIG_NET_TCP=y

# Enable POSIX API for compatibility
CONFIG_NET_SOCKETS_POSIX_NAMES=y
```

## src/main.c
```c
/*
 * Copyright (c) 2021 Nordic Semiconductor ASA
 * SPDX-License-Identifier: Apache-2.0
 */
 
#include <zephyr/sys/printk.h>
#include <zephyr/kernel.h>
#include <zephyr/drivers/sensor.h>
#include "app_version.h"

#include <zephyr/toolchain.h>
#include <stddef.h>
#include <stdarg.h>
#include <inttypes.h>
 
#include <stdio.h>

#include <zephyr/logging/log.h>
LOG_MODULE_REGISTER(main_log, LOG_LEVEL_DBG);

#include "../includes/bmi_160/bmi_160.c"

Server server;
int main(void)
{
	
	if(startWebsocket(&server)){
		LOG_WRN("Press 'y to start websocket ");
		char s;
		while (true) 
		{
			scanf(" %c", &s);
			if(s == 'w'){
				reg_write(&server, 4, 6);
			}
			else if(s == 'r'){
				reg_read(&server, 2);
			}
			else{
				reg_write(&server, 5, 100);
				LOG_ERR("Socket closing");
				break;
			}
			
		}
		close(server.new_socket);
		shutdown(server.server_fd, SHUT_RDWR);
	}
	else{
		LOG_ERR("Could not start socket." );
		close(server.new_socket);
		shutdown(server.server_fd, SHUT_RDWR);
	}
	
	return 0;
}
	
	
```

## src/simple.pb.h
```c
/* Automatically generated nanopb header */
/* Generated by nanopb-0.4.6 */

#ifndef PB_SIMPLE_PB_H_INCLUDED
#define PB_SIMPLE_PB_H_INCLUDED
#include <pb.h>

#if PB_PROTO_HEADER_VERSION != 40
#error Regenerate this file with the current version of nanopb generator.
#endif

/* Struct definitions */
typedef struct _SimpleMessage { 
    int32_t regNum;
    int32_t val;
    int32_t read;
} SimpleMessage;


#ifdef __cplusplus
extern "C" {
#endif

/* Initializer values for message structs */
#define SimpleMessage_init_default               {0, 0, 0}
#define SimpleMessage_init_zero                  {0, 0, 0}

/* Field tags (for use in manual encoding/decoding) */
#define SimpleMessage_regNum_tag                 1
#define SimpleMessage_val_tag                    2
#define SimpleMessage_read_tag                   3

/* Struct field encoding specification for nanopb */
#define SimpleMessage_FIELDLIST(X, a) \
X(a, STATIC,   SINGULAR, INT32,    regNum,            1) \
X(a, STATIC,   SINGULAR, INT32,    val,               2) \
X(a, STATIC,   SINGULAR, INT32,    read,              3)
#define SimpleMessage_CALLBACK NULL
#define SimpleMessage_DEFAULT NULL

extern const pb_msgdesc_t SimpleMessage_msg;

/* Defines for backwards compatibility with code written before nanopb-0.4.0 */
#define SimpleMessage_fields &SimpleMessage_msg

/* Maximum encoded size of messages (where known) */
#define SimpleMessage_size                       33

#ifdef __cplusplus
} /* extern "C" */
#endif

#endif
```
